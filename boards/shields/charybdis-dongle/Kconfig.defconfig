## boards/shields/charybdis-dongle/Kconfig.defconfig
```kconfig
if SHIELD_CHARYBDIS_DONGLE || SHIELD_CHARYBDIS_DONGLE_DISPLAY || SHIELD_CHARYBDIS_DONGLE_PROSPECTOR

config ZMK_KEYBOARD_NAME
	default "Charybdis"

config ZMK_SPLIT_ROLE_CENTRAL
	default y

endif

if SHIELD_CHARYBDIS_LEFT || SHIELD_CHARYBDIS_RIGHT || SHIELD_CHARYBDIS_DONGLE || SHIELD_CHARYBDIS_DONGLE_DISPLAY || SHIELD_CHARYBDIS_DONGLE_PROSPECTOR

config ZMK_SPLIT
	default y
	
endif

if SHIELD_CHARYBDIS_DONGLE_DISPLAY

if ZMK_DISPLAY

config I2C
    default y

config SSD1306
    default y

choice ZMK_DISPLAY_WORK_QUEUE
    default ZMK_DISPLAY_WORK_QUEUE_DEDICATED
endchoice

if LVGL

config LV_Z_VDB_SIZE
    default 64

config LV_DPI_DEF
    default 148

config LV_Z_BITS_PER_PIXEL
    default 1

choice LV_COLOR_DEPTH
    default LV_COLOR_DEPTH_1
endchoice

endif # LVGL

endif # ZMK_DISPLAY

endif # SHIELD_CHARYBDIS_DONGLE_DISPLAY
```

## boards/shields/charybdis-dongle/Kconfig.shield
```kconfig
config SHIELD_CHARYBDIS_DONGLE_DISPLAY
	def_bool $(shields_list_contains,dongle_display)

config SHIELD_CHARYBDIS_DONGLE
	def_bool $(shields_list_contains,charybdis_dongle)

config SHIELD_CHARYBDIS_DONGLE_PROSPECTOR
	def_bool $(shields_list_contains,charybdis_dongle_prospector)

config SHIELD_CHARYBDIS_LEFT
	def_bool $(shields_list_contains,charybdis_left)

config SHIELD_CHARYBDIS_RIGHT
	def_bool $(shields_list_contains,charybdis_right)
```

## config/west.yml
```yaml
manifest:
  remotes:
    - name: zmkfirmware
      url-base: https://github.com/zmkfirmware
    - name: badjeff
      url-base: https://github.com/badjeff
#    - name: carrefinho
#      url-base: https://github.com/thewinger
    - name: carrefinho
      url-base: https://github.com/bukharovsi
    - name: urob
      url-base: https://github.com/urob
#    - name: englmaxi
#      url-base: https://github.com/englmaxi
    - name: janpfischer
      url-base: https://github.com/Bukharovsi
  projects:
    - name: zmk
      remote: zmkfirmware
      revision: main
      import: app/west.yml
    - name: zmk-pmw3610-driver
      remote: badjeff
      revision: main
    - name: zmk-split-peripheral-input-relay
      remote: badjeff
      revision: main
    - name: prospector-zmk-module
      remote: carrefinho
      revision: main
    - name: zmk-helpers
      remote: urob
      revision: main
#    - name: zmk-dongle-display
#      remote: englmaxi
#      revision: main
    - name: zmk-dongle-screen
      remote: janpfischer
      revision: main
  self:
    path: config
```
